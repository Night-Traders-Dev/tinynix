## tinynix_defconfig
```kconfig
# -----------------------------------------------------------------------------
# Architecture / CPU
# -----------------------------------------------------------------------------
BR2_aarch64=y
BR2_CORTEX_A53=y

# -----------------------------------------------------------------------------
# System identity / login banner
# -----------------------------------------------------------------------------
BR2_TARGET_GENERIC_HOSTNAME="KrakenHost"
BR2_TARGET_GENERIC_ISSUE="Welcome to Kraken Linux"
BR2_TARGET_GENERIC_ROOT_PASSWD="root"

# -----------------------------------------------------------------------------
# Kernel / headers (disabled)
# -----------------------------------------------------------------------------
# BR2_LINUX_KERNEL is not set
# BR2_KERNEL_HEADERS_AS_KERNEL is not set
# BR2_PACKAGE_LINUX_HEADERS is not set

# -----------------------------------------------------------------------------
# Init system / shell
# -----------------------------------------------------------------------------
BR2_INIT_BUSYBOX=y
BR2_PACKAGE_BUSYBOX=y

BR2_PACKAGE_ZSH=y
BR2_SYSTEM_BIN_SH_BUSYBOX=y
BR2_SYSTEM_BIN_SH_ZSH=y

# -----------------------------------------------------------------------------
# Base userland / common utilities
# -----------------------------------------------------------------------------
BR2_PACKAGE_COREUTILS=y
BR2_PACKAGE_UTIL_LINUX=y
BR2_PACKAGE_PROCPS_NG=y
BR2_PACKAGE_NCURSES=y
BR2_PACKAGE_E2FSPROGS=y
BR2_PACKAGE_GAWK=y
BR2_PACKAGE_RSYNC=y
BR2_PACKAGE_DOSFSTOOLS=y
BR2_PACKAGE_SCREEN=y
BR2_PACKAGE_TMUX=y
BR2_PACKAGE_PARTED=y

# -----------------------------------------------------------------------------
# Libraries / crypto / data formats
# -----------------------------------------------------------------------------
BR2_PACKAGE_ZLIB=y
BR2_PACKAGE_OPENSSL=y
BR2_PACKAGE_LIBCONFIG=y
BR2_PACKAGE_LIBCURL=y

# -----------------------------------------------------------------------------
# CLI tools / editors / misc
# -----------------------------------------------------------------------------
BR2_PACKAGE_HTOP=y
BR2_PACKAGE_NEOFETCH=y
BR2_PACKAGE_NANO=y
BR2_PACKAGE_FILE=y
BR2_PACKAGE_FINDUTILS=y
BR2_PACKAGE_GREP=y
BR2_PACKAGE_SED=y
BR2_PACKAGE_TAR=y
BR2_PACKAGE_WHICH=y
BR2_PACKAGE_GIT=y

# -----------------------------------------------------------------------------
# Networking / Wi-Fi / remote access
# -----------------------------------------------------------------------------
BR2_PACKAGE_IPUTILS=y
BR2_PACKAGE_NET_TOOLS=y
BR2_PACKAGE_IPROUTE2=y
BR2_PACKAGE_DHCPCD=y
BR2_PACKAGE_OPENSSH=y
BR2_PACKAGE_WGET=y
BR2_PACKAGE_WPA_SUPPLICANT=y
BR2_PACKAGE_IW=y

# -----------------------------------------------------------------------------
# Toolchain / libc / profiling
# -----------------------------------------------------------------------------
BR2_BINUTILS_GPROFNG=y
BR2_PACKAGE_GLIBC_UTILS=y
BR2_TOOLCHAIN_BUILDROOT_CXX=y

# -----------------------------------------------------------------------------
# Languages / runtimes
# -----------------------------------------------------------------------------
BR2_PACKAGE_MICROPYTHON=y

# -----------------------------------------------------------------------------
# Root filesystem image: ext2/4
# -----------------------------------------------------------------------------
BR2_TARGET_ROOTFS_EXT2=y
BR2_TARGET_ROOTFS_EXT2_4=y
BR2_TARGET_ROOTFS_EXT2_GEN=4
BR2_TARGET_ROOTFS_EXT2_LABEL="rootfs"
BR2_TARGET_ROOTFS_EXT2_SIZE="4G"
BR2_TARGET_ROOTFS_EXT2_INODES=0
BR2_TARGET_ROOTFS_EXT2_INODE_SIZE=256
BR2_TARGET_ROOTFS_EXT2_RESBLKS=5
BR2_TARGET_ROOTFS_EXT2_MKFS_OPTIONS="-O 64bit"
BR2_TARGET_ROOTFS_EXT2_NONE=y
```
